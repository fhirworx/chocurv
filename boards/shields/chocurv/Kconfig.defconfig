## boards/shields/chocurv/Kconfig.defconfig
```kconfig
if SHIELD_CHOCURV_LEFT

config ZMK_KEYBOARD_NAME
    default "chocurv"

config ZMK_SPLIT_ROLE_CENTRAL
    default y

endif

if SHIELD_CHOCURV_LEFT || SHIELD_CHOCURV_RIGHT

config ZMK_SPLIT
    default y

endif
```

## boards/shields/chocurv/Kconfig.shield
```kconfig
config SHIELD_CHOCURV_LEFT
    def_bool $(shields_list_contains,chocurv_left)

config SHIELD_CHOCURV_RIGHT
    def_bool $(shields_list_contains,chocurv_right)
```
